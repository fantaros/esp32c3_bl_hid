## firmware/sdkconfig.defaults
```kconfig
# Target
TARGET_CHIP=esp32c3

# USB - TinyUSB Device (Composite HID + CDC)
CONFIG_TINYUSB=y
CONFIG_TINYUSB_DEVICE=y
CONFIG_TINYUSB_DEVICE_ENABLED=y
CONFIG_TINYUSB_CDC_ENABLED=y
CONFIG_TINYUSB_HID_ENABLED=y
CONFIG_TINYUSB_HID_CLASS_ENABLED=y
CONFIG_TINYUSB_MSC_ENABLED=n
CONFIG_TINYUSB_NET_ENABLED=n
CONFIG_TINYUSB_DFU_ENABLED=n
CONFIG_TINYUSB_WECHART_ENABLED=n
CONFIG_TINYUSB_VENDOR_ENABLED=n

# USB - ESP32C3 USB OTG peripheral as device
CONFIG_USB_OTG_DISABLED=n
CONFIG_USB_ENABLED=y
CONFIG_USB_DEVICE_ENABLED=y

# NimBLE - BLE stack
CONFIG_BT_ENABLED=y
CONFIG_BT_NIMBLE_ENABLED=y
CONFIG_BT_NIMBLE_HOST_ENABLED=y
CONFIG_BT_NIMBLE_IDLE_CONNECTION_CB_ENABLED=n
CONFIG_BT_NIMBLE_ROLE_CENTRAL=y
CONFIG_BT_NIMBLE_ROLE_PERIPHERAL=n
CONFIG_BT_NIMBLE_ROLE_BROADCASTER=n
CONFIG_BT_NIMBLE_ROLE_OBSERVER=y
CONFIG_BT_NIMBLE_SCAN_API=y
CONFIG_BT_NIMBLE_GATT_CLIENT=y
CONFIG_BT_NIMBLE_MAX_CONNECTIONS=4
CONFIG_BT_NIMBLE_MAX_SCAN_RESULTS=16
CONFIG_BT_NIMBLE_DEFAULT_MTU=247

# Logging
CONFIG_LOG_DEFAULT_LEVEL_INFO=y
CONFIG_LOG_COLORS=y

# FreeRTOS
CONFIG_FREERTOS_HZ=1000

# Heap
CONFIG_ESP_MAIN_TASK_STACK_SIZE=4096
```
